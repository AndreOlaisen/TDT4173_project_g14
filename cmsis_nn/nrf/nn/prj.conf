## CMakeLists.txt
```
#
# Copyright (c) 2019 Nordic Semiconductor
#
# SPDX-License-Identifier: LicenseRef-BSD-5-Clause-Nordic
#

cmake_minimum_required(VERSION 3.13.1)

find_package(Zephyr REQUIRED HINTS $ENV{ZEPHYR_BASE})
project("CMSIS-NN sample")

set(app_sources src/main.c)

if (NOT CONFIG_BOARD_NRF9160DK_NRF52840)
FILE(GLOB model_sources model/*.c)
set (app_sources ${app_sources} ${model_sources})
endif()

target_sources(app PRIVATE ${app_sources})
target_include_directories(app PRIVATE .)
```

## prj.conf
```kconfig
CONFIG_NCS_SAMPLES_DEFAULTS=y
CONFIG_ASSERT=y
CONFIG_CONSOLE=y
CONFIG_UART_CONSOLE=y
CONFIG_RTT_CONSOLE=n

CONFIG_POLL=y
CONFIG_SERIAL=y
CONFIG_UART_ASYNC_API=y
CONFIG_UART_INTERRUPT_DRIVEN=n

CONFIG_CMSIS_NN=y
CONFIG_NEWLIB_LIBC=y

CONFIG_MAIN_STACK_SIZE=16384
```

## boards/nrf9160dk_nrf9160ns.overlay
```dts
/* uart1 is used for VCOM2 communication. */
&uart1 {
	compatible = "nordic,nrf-uarte";
	current-speed = <115200>; 
	status = "okay";
/*
	tx-pin = <1>;
	rx-pin = <0>;
	rts-pin = <14>;
	cts-pin = <15>;
*/
	hw-flow-control;
};

/* uart2 is used for nRF52840 communication. */
&uart2 {
	compatible = "nordic,nrf-uarte";
	current-speed = <1000000>; 
	status = "okay";
	tx-pin = <18>;
	rx-pin = <17>;
	rts-pin = <21>;
	cts-pin = <19>;
	hw-flow-control;
};
```

## src/main.c
```c
#include <zephyr.h>
#include <stdint.h>
#include <drivers/uart.h>
#include <arm_math.h>

#define IMG_DIM         32
#define IMG_CH          3
#define IMG_CATEGORIES  10

#define VCOM_UART_LABEL	DT_LABEL(DT_NODELABEL(uart1))
#define NRF_UART_LABEL	DT_LABEL(DT_NODELABEL(uart2))

int nn_forward_pass(uint8_t *img, q7_t *out);

static const struct device *vcom_uart_dev;
static const struct device *nrf_uart_dev;
static uint8_t img[IMG_DIM * IMG_DIM * IMG_CH];
static struct k_poll_signal sig_ready = K_POLL_SIGNAL_INITIALIZER(sig_ready);


static void uart_async_cb(const struct device *dev,
			  struct uart_event *evt,
			  void *user_data)
{
	if (dev == vcom_uart_dev && evt->type == UART_RX_DISABLED) {
		k_poll_signal_raise(&sig_ready, 0);
	}
}

static void uart_init(const struct device **dev, const char *label)
{
	*dev = device_get_binding(label);
	__ASSERT(*dev != NULL, "Unable to get UART device.");
	int err = uart_callback_set(*dev, uart_async_cb, NULL);
	__ASSERT(err == 0, "Error %d setting UART callback.", err);
}


void main(void)
{
	q7_t out[IMG_CATEGORIES];

	printk("Starting NN example.\n");
	
	k_poll_signal_init(&sig_ready);
	struct k_poll_event evt_ready = K_POLL_EVENT_INITIALIZER(
		K_POLL_TYPE_SIGNAL, K_POLL_MODE_NOTIFY_ONLY, &sig_ready);

	uart_init(&vcom_uart_dev, VCOM_UART_LABEL);
	uart_init(&nrf_uart_dev, NRF_UART_LABEL);

	for (;;) {
		uart_rx_enable(vcom_uart_dev, img, sizeof(img), SYS_FOREVER_MS);
		k_poll(&evt_ready, 1, K_FOREVER);
		evt_ready.signal->signaled = 0;
		evt_ready.state = K_POLL_STATE_NOT_READY;
		printk("Image received - performing forward pass\n");

		nn_forward_pass(img, out);

		uart_tx(vcom_uart_dev, (uint8_t *) out, sizeof(out),
			SYS_FOREVER_MS);
		uart_tx(nrf_uart_dev, (uint8_t *) out, sizeof(out),
			SYS_FOREVER_MS);
		printk("Sent output:\n");
		for (int i = 0; i < IMG_CATEGORIES; i++) {
			printk("    %d: %hhd\n", i, out[i]);
		}
	}
}
```
